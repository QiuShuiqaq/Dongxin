## firmware/main/Kconfig.projbuild
```kconfig
menu "Dongxin board configuration"

choice DX_BOARD_PROFILE
    prompt "ESP32-C3 development board"
    default DX_BOARD_C3_SUPERMINI

    config DX_BOARD_C3_SUPERMINI
        bool "ESP32-C3 SuperMini"

    config DX_BOARD_C3_LICHUANG_AUDIO
        bool "Lichuang ESP32-C3 audio board"
endchoice

config DX_CLOUD_PILOT
    bool "Use private per-device cloud pilot configuration"
    default n
    help
        Include main/device_provisioning.h, which must be created locally and
        must not be committed. This is for a single device pilot only; mass
        production requires a separate per-unit provisioning process.

config DX_WIFI_PROVISIONING
    bool "Enable local Wi-Fi setup portal"
    default n
    help
        Enable a time-limited, password-protected SoftAP setup page. The
        device needs a unique DX_WIFI_SETUP_PASSWORD in its private header.
        Current cloud pilot builds keep this disabled until the setup entry
        and per-device label are verified.

endmenu
```
